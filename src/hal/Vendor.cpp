#include "Vendor.h"

namespace {
struct Oui { uint8_t p[3]; const char* name; };

// Curated common consumer OUIs. Many vendors own dozens of blocks; these are
// frequently-seen ones. Unknown -> "".
const Oui kOui[] = {
    {{0x3C,0x22,0xFB}, "Apple"},   {{0xAC,0xDE,0x48}, "Apple"},
    {{0xF0,0x18,0x98}, "Apple"},   {{0xA4,0x83,0xE7}, "Apple"},
    {{0xDC,0xA6,0x32}, "RaspiPi"}, {{0xB8,0x27,0xEB}, "RaspiPi"},
    {{0x24,0x0A,0xC4}, "Espressif"},{{0x24,0x6F,0x28},"Espressif"},
    {{0x7C,0xDF,0xA1}, "Espressif"},{{0x30,0xAE,0xA4},"Espressif"},
    {{0x34,0xAB,0x95}, "Espressif"},{{0xA0,0x20,0xA6},"Espressif"},
    {{0xFC,0xF5,0xC4}, "Espressif"},{{0x8C,0xAA,0xB5},"Espressif"},
    {{0x50,0x02,0x91}, "Espressif"},
    {{0x00,0x1A,0x11}, "Google"},  {{0xF4,0xF5,0xD8}, "Google"},
    {{0x44,0x07,0x0B}, "Google"},  {{0x1C,0x53,0xF9}, "Amazon"},
    {{0x68,0x37,0xE9}, "Amazon"},  {{0xFC,0xA1,0x83}, "Amazon"},
    {{0x44,0x65,0x0D}, "Amazon"},  {{0x50,0xF5,0xDA}, "Amazon"},
    {{0xC0,0x97,0x27}, "Samsung"}, {{0x8C,0x77,0x12}, "Samsung"},
    {{0x5C,0x0A,0x5B}, "Samsung"}, {{0xE8,0x50,0x8B}, "Samsung"},
    {{0x34,0x23,0xBA}, "Samsung"}, {{0x78,0xBD,0xBC}, "Samsung"},
    {{0x50,0xC7,0xBF}, "TP-Link"}, {{0x14,0xCC,0x20}, "TP-Link"},
    {{0xAC,0x84,0xC6}, "TP-Link"}, {{0x68,0xFF,0x7B}, "TP-Link"},
    {{0x00,0x15,0x5D}, "MS/Hyper-V"},{{0x7C,0x1E,0x52}, "Microsoft"},
    {{0x00,0x50,0xF2}, "Microsoft"},{{0xD8,0xF2,0xCA}, "Intel"},
    {{0x34,0x02,0x86}, "Intel"},   {{0xA4,0xC3,0xF0}, "Intel"},
    {{0x18,0xB4,0x30}, "Nest"},    {{0x64,0x16,0x66}, "Nest"},
    {{0x00,0x9D,0x6B}, "Amcrest"}, {{0x9C,0x8E,0xCD}, "Ring"},
    {{0x00,0x62,0x6E}, "Ring"},    {{0xB0,0x09,0xDA}, "Ring"},
    {{0xE0,0xB9,0x4D}, "Wyze"},    {{0x2C,0xAA,0x8E}, "Wyze"},
    {{0x50,0xEC,0x50}, "Belkin"},  {{0x08,0x86,0x3B}, "Belkin"},
    {{0x60,0x01,0x94}, "Espressif"},{{0x44,0x17,0x93},"Espressif"},
    {{0x18,0xFE,0x34}, "Espressif"},{{0x28,0x6C,0x07},"Xiaomi"},
    {{0x64,0x09,0x80}, "Xiaomi"},  {{0xF8,0xA7,0x63}, "Xiaomi"},
    {{0x00,0x1A,0x79}, "Ubiquiti"},{{0xFC,0xEC,0xDA}, "Ubiquiti"},
    {{0x78,0x8A,0x20}, "Ubiquiti"},{{0x24,0x5A,0x4C}, "Ubiquiti"},
    {{0x00,0x0C,0x29}, "VMware"},  {{0xB4,0xFB,0xE4}, "Ubiquiti"},
};

struct CoId { uint16_t id; const char* name; };
const CoId kCo[] = {
    {0x004C, "Apple"},   {0x0006, "Microsoft"}, {0x00E0, "Google"},
    {0x0075, "Samsung"}, {0x0087, "Garmin"},    {0x0157, "Huawei"},
    {0x038F, "Xiaomi"},  {0x0171, "Amazon"},    {0x05A7, "Sonos"},
    {0x004F, "Logitech"},{0x02E5, "Espressif"}, {0x0059, "Nordic"},
    {0x0001, "Ericsson"},{0x000D, "TI"},        {0x0499, "Ruuvi"},
    {0x0118, "Tile"},    {0x0A12, "Ring"},      {0x022B, "Tesla"},
};
}

const char* vendor::forOui(const uint8_t* mac) {
    if (isRandom(mac)) return "random";      // locally-administered / randomized
    for (auto& o : kOui)
        if (o.p[0] == mac[0] && o.p[1] == mac[1] && o.p[2] == mac[2]) return o.name;
    return "";
}

const char* vendor::forCompanyId(uint16_t id) {
    for (auto& c : kCo) if (c.id == id) return c.name;
    return "";
}
